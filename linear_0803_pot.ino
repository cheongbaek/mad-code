// ============================================================
//  linear_0803_pot.ino : 리니어(브레이크) 행정 최대·최소 실측 (Arduino Mega 2560)
//
//  ★ 목적 ★
//    엔코더로 리니어의 위치를 알 수 있게 됐으니(linear_0803.ino에서 동작 확인 완료),
//    PD 위치제어에 앞서 **행정 범위(끝에서 끝까지 몇 카운트인지)** 를 먼저 재는 코드다.
//    조향에서 dc_0701_potential.ino로 가변저항 좌/우 끝값을 재고 그 값으로 안전 구동범위를
//    잡았던 것과 정확히 같은 역할이다 — 여기서 얻은 최대값이 PD제어의 상한이 된다.
//
//  ★ 아주 단순하다 ★
//    - 아두이노가 켜진 순간의 위치가 **항상 영점(0)** 이다.
//    - 그 뒤로는 영점 대비 변화량 하나만, 정수로, 한 줄에 하나씩 출력한다.
//
//  ★ 입력 : 시리얼 모니터에 "0" (115200, ★개행 전송★) ★
//    지금 위치를 새 영점으로 잡는다. 반대쪽 끝에서 눌러 0으로 만들고 되돌아오며 재보면
//    같은 행정을 반대 방향으로 교차검증할 수 있다.
//    - 정확히 "0" 한 줄만 인정한다("10", "0 " 같은 것은 무시). 그 외 입력도 전부 무시.
//    - 문자 단위가 아니라 줄 단위로 받는 이유 : 나중에 이 코드를 PD 버전으로 확장해
//      목표값("1000" 등)을 입력받게 되면, 문자 '0'에 반응하는 방식은 목표값 입력 도중에
//      영점이 튀어버린다. 지금부터 줄 단위로 두는 편이 안전하다.
//    - 아두이노 리셋 버튼을 눌러도 같은 효과다(그 순간의 위치가 새 0).
//
//  ★ 사용법 ★
//    1) 리니어 로드를 한쪽 끝(예: 완전히 수축 = 브레이크 안 밟은 쪽)에 둔다.
//    2) 그 상태에서 아두이노를 켠다(또는 리셋). -> 그 위치가 0이 된다.
//    3) 로드를 반대쪽 끝까지 천천히 움직인다. 이 코드는 모터를 구동하지 않으므로
//       손으로 돌리거나 linear_0731.ino 같은 구동 코드로 움직인다.
//       ※ 구동 코드로 움직일 때는 D8/D9(DIR/PWM)를 쓰는 그 코드를 올려야 하므로,
//         이 스케치와 동시에 쓸 수 없다. 손으로 움직이는 쪽이 이 측정에는 안전하다.
//    4) 끝에 닿았을 때 시리얼 모니터에 마지막으로 찍힌 숫자 = 행정 전체 카운트.
//       그 값이 PD제어의 최대 위치가 되고, 실제로는 여기서 안전여유를 뺀 범위만 쓴다
//       (dc_0702_pd.ino의 SAFETY_MARGIN과 같은 개념).
//    5) (선택) 그 끝에서 "0"을 입력해 영점을 옮기고 반대로 되돌아오며 다시 읽으면,
//       같은 행정을 반대 방향으로 재확인할 수 있다(두 값이 크게 다르면 미끄러짐/유실 의심).
//
//  ★ 배선 (엔코더만, 2·3번 핀만 사용) ★
//      OUT A -> D2 (INT4) / OUT B -> D3 (INT5) / OUT C(Z) 미사용 / 5V / GND
//      엔코더 : E40S8-2048-3-T-5 (2048PPR, 토템폴, 5V 전용 — 12V 금지)
//      계수   : A/B 양쪽 CHANGE 인터럽트 = x4 -> 1회전 8192 카운트
//               (전이오류 검사·방향표시 등 진단 출력은 linear_0803.ino가 담당)
//
//  ★ 출력 : REPORT_MS(5ms)마다 정수 하나 (조건 없이 항상) ★
//        0
//        128
//        1044
//      값이 변하지 않아도 매 주기 찍는다 — 등간격 표본이라야 로그에서 속도(변화량/주기)와
//      양자화 잡음을 그대로 읽을 수 있고, PD의 D항이 무엇을 보게 될지 미리 판단할 수 있다.
//      PD는 20ms로 돌 예정이므로(CLAUDE.md 1절), 5ms 로그에서 4개씩 골라내면 그 주기가 된다.
//      ※ 숫자 하나만 나오므로 시리얼 플로터(Tools > Serial Plotter)로 그래프로도 볼 수 있다.
//      ※ 끝까지 움직였는데 값이 음수로 나오면 아래 INVERT_DIR을 true로 바꾼다
//        (부호만 뒤집힐 뿐이라 절댓값을 읽어도 결과는 같다).
//      ※ "# ERR n" 줄이 나오면 엣지를 놓친 것이다 (아래 참고). 정상이면 이 줄이 안 나온다.
//
//  ★★ 출력 간격과 '펄스 누락'은 별개다 (오차 진단의 출발점) ★★
//    카운트는 전부 인터럽트(ISR)에서 세고, Serial.println은 이미 세어둔 값을 꺼내 보여줄
//    뿐이다. 그래서 REPORT_MS를 줄이면 '더 자세히 관찰'은 되지만 누락은 줄어들지 않는다.
//    애초에 모든 카운트를 찍는 것은 불가능하다 — 8192카운트/회전이라 축이 1회전/초만 돌아도
//    8192줄/초(약 57KB/s)가 필요한데 115200baud는 11.5KB/s뿐이다.
//
//    ▶ 누락이 실제로 생기는 조건은 '축 회전이 ISR 처리 속도를 넘을 때'다.
//      엣지 발생률 = 8192 x (RPM/60) = 약 136.5 x RPM [회/초]
//        - attachInterrupt 방식 ISR : 1회 약 5~6us -> 약 1,200RPM에서 CPU 100% (그 전부터 누락)
//        - 아래처럼 ISR 벡터 직결   : 1회 약 2~3us -> 약 2,500RPM까지 여유
//      그래서 이 파일은 attachInterrupt를 버리고 INT4/INT5 벡터에 직접 붙였다(약 2배 여유).
//      엔코더 자체 응답주파수(데이터시트 확인 권장, E40S 계열 보통 수십~300kHz)는 이보다 훨씬
//      높으므로, 이 조합에서 병목은 항상 아두이노 쪽이다.
//
//    ▶ 그래도 같은 위치에서 값이 틀어진다면 계산해 볼 것 : 1카운트 = 360/8192 = 0.044도.
//      80카운트면 엔코더 축이 3.5도 돈 것이다. 커플링 유격·벨트 미끄러짐이나 "같은 위치"를
//      눈으로 맞춘 오차만으로도 충분히 나오는 크기다. 즉 전기적 누락이 아닐 수 있다.
//      ▷ 판별법 : 아래 "# ERR"이 안 나오는데 값이 틀어지면 → 기계적 유격/기준 판정 문제.
//                 "# ERR"이 늘어나면 → 진짜 엣지 누락(너무 빠름 또는 배선 노이즈).
//                 배선 노이즈 의심 시 linear_0803.ino로 방향·오류를 함께 보며 확인한다.
//
//  ★★ 실측 기록 (2026-08-04, 페달 밟았다 뗐다 5회) ★★
//      0 -> 380 -> 4 -> 399 -> -63 -> 309 -> -106 -> 233 -> -187 -> 158 -> -242
//      행정 크기(밟음-뗌)는 380/395/372/339/345로 거의 일정한데, 뗀 위치(기준점)만
//      0, +4, -63, -106, -187, -242 로 한 방향으로 계속 걸어갔다(평균 -55/사이클).
//      환산하면 전체 행정 400카운트 = 17.6도, 사이클당 -55카운트 = -2.4도(행정의 약 14%).
//      ▷ '행정 크기는 일정한데 기준점만 단조 이동' = 기계적 미끄러짐/기준점 이동의 전형적 형태다
//        (엣지 유실이라면 움직이는 도중에 잃으므로 행정 크기 자체도 흔들린다).
//        다만 한쪽 방향이 훨씬 빠르면(발로 미는 것 vs 스프링 복귀) 그 방향만 덜 세어져 같은
//        모양이 나올 수 있어서, 아래 RECOVER_LOST_EDGES 보정과 "# ERR" 보고를 함께 넣었다.
//      ▷ ★구조적 결론★ 증분(incremental) 엔코더는 원리적으로 절대위치를 모른다. 매 사이클
//        조금씩 밀리는 것을 코드로 완전히 없앨 수는 없으므로, PD 버전에서는 반드시
//        '기준으로 되돌아왔을 때 다시 0으로 맞추는' 수단(리미트 스위치 / 페달 가변저항)을
//        함께 써야 한다. 여기서 재는 것은 어디까지나 '행정 크기'다.
//
//  동작 : delay() 미사용, millis() 기준 논블로킹 (카운트는 인터럽트로만 갱신)
// ============================================================


// ================= 핀 (2·3번만) =================
// Mega 2560의 외부 인터럽트 핀은 D2, D3, D18~D21뿐이다.
// 아래 readAB()가 D2/D3를 포트로 직접 읽으므로 핀을 바꾸면 그 함수도 함께 고쳐야 한다.
const uint8_t ENC_A_PIN = 2;
const uint8_t ENC_B_PIN = 3;


// ================= 엔코더 스펙 =================
const long PPR            = 2048;      // A상 1회전당 펄스 수
const long COUNTS_PER_REV = PPR * 4;   // x4 디코딩 -> 8192 (참고용. 이 코드는 카운트만 쓴다)


// ================= 옵션 =================
// 토템폴(T) 출력이라 풀업 없이 INPUT이 맞다. 실물이 오픈컬렉터(N)면 true로.
const bool USE_PULLUP = false;

// 움직인 방향이 음수로 나올 때만 true로 (A/B를 서로 바꿔 꽂는 것과 같은 효과)
const bool INVERT_DIR = false;

// ★ 유실 엣지 보정 (2026-08-04 추가) ★
//   A와 B가 '동시에' 바뀐 것으로 보이면 중간 상태를 하나 건너뛴 것이므로, 실제로는
//   정확히 2카운트가 지나갔다. 방향만 알 수 없다. 그래서 직전에 확정된 진행 방향을
//   그대로 이어 붙여 ±2를 더한다.
//     - 페달처럼 한 방향으로 쭉 움직이는 동작에서는 이 추정이 거의 항상 맞다.
//     - false로 두면 예전처럼 그 2카운트를 버린다(= 한 방향이 빠를 때 그 방향만 덜 세어져
//       매 사이클 한쪽으로 기준점이 밀리는 원인이 된다).
//   ※ 보정을 켜도 유실 자체는 "# ERR"로 계속 보고되므로, 원인 판별에는 영향이 없다.
const bool RECOVER_LOST_EDGES = true;

// 출력(관찰) 주기. 5ms = 200줄/초 x 약 7바이트 = 1.4KB/s 로 115200baud(11.5KB/s)에 여유가 있다.
// ★ 이 값은 '얼마나 자세히 보는가'만 정한다 — 펄스 누락과는 무관하다(헤더 참고) ★
// PD는 20ms로 돌 예정이므로 이 로그에서 4개씩 골라 쓰면 그 주기가 된다.
// 더 줄이려면 2ms(=500줄/초, 3.5KB/s)까지는 가능하지만, 그 이하는 BAUD를 250000으로 올려야 한다.
const unsigned long REPORT_MS = 5;

const unsigned long BAUD = 115200;


// ================= x4 쿼드러처 전이 표 =================
// 상태 = (A<<1)|B, 인덱스 = (이전<<2)|현재.
// +1/-1 = 정상 전이(부호=방향), 0 = 변화 없음 또는 두 비트 동시 변화(엣지 유실).
// 유실은 여기서 그냥 무시한다 — 엔코더 자체 검증은 linear_0803.ino에서 이미 끝냈다.
const int8_t QDEC_TABLE[16] = {
   0, +1, -1,  0,
  -1,  0,  0, +1,
  +1,  0,  0, -1,
   0, -1, +1,  0
};


// ================= ISR이 갱신하는 값 =================
// ★ 켜질 때 0으로 시작하는 것이 곧 '부팅 위치 = 영점' 규약이다 ★
// long은 4바이트라 읽기가 원자적이지 않다 -> loop에서 읽을 때 noInterrupts()로 감싼다.
volatile long     enc_count = 0;
volatile uint8_t  enc_state = 0;   // 직전 (A<<1)|B
volatile uint16_t enc_err   = 0;   // 엣지 유실 횟수 (A와 B가 동시에 바뀐 것으로 보인 경우)
volatile int8_t   enc_dir   = 0;   // 마지막으로 확정된 진행 방향(+1/-1) — 유실 보정에 쓴다


// ================= A/B 레벨 읽기 =================
// ★ Mega 2560 : D2 = PE4, D3 = PE5 ★ (Uno와 포트가 다르다)
//   포트를 한 번에 읽으므로 빠르고(약 0.2us), A/B가 서로 어긋나 읽힐 일도 없다.
static inline uint8_t readAB() {
  uint8_t p = PINE;
  uint8_t a = (p >> 4) & 0x01;   // PE4 = D2
  uint8_t b = (p >> 5) & 0x01;   // PE5 = D3
  return (uint8_t)((a << 1) | b);
}


// ================= 엔코더 1엣지 처리 (두 ISR이 공유) =================
// always_inline이라 아래 두 벡터 안에 코드가 그대로 박힌다(함수 호출 오버헤드 0).
// 시리얼 출력은 절대 하지 않는다(느리고 위험).
static inline void encStep() __attribute__((always_inline));
static inline void encStep() {
  uint8_t cur  = readAB();
  uint8_t prev = enc_state;
  if (cur == prev) return;                    // 같은 상태로의 인터럽트(글리치) — 무시
  enc_state = cur;

  int8_t step = QDEC_TABLE[(prev << 2) | cur];
  if (step == 0) {
    // A와 B가 동시에 바뀐 것으로 보인다 = 중간 상태를 하나 건너뛰었다(= 정확히 2카운트).
    // 방향만 알 수 없으므로 직전 진행 방향을 이어 붙인다(RECOVER_LOST_EDGES 주석 참고).
    enc_err++;
    if (RECOVER_LOST_EDGES && enc_dir != 0) {
      enc_count += (long)(INVERT_DIR ? -enc_dir : enc_dir) * 2;
    }
    return;
  }
  enc_dir = step;                    // 정상 전이에서만 방향을 갱신한다
  enc_count += INVERT_DIR ? -step : step;
}


// ================= ISR 벡터 직결 (INT4=D2, INT5=D3) =================
// ★ attachInterrupt를 쓰지 않는 이유 ★
//   attachInterrupt는 공용 핸들러에서 함수 포인터 테이블을 거쳐 우리 함수를 '호출'한다.
//   그 과정에서 레지스터를 대량 저장/복원해 1회 약 5~6us가 든다. 8192카운트/회전이라
//   엣지 발생률이 약 136.5 x RPM 이므로, 그 오버헤드가 곧 누락 한계를 정한다
//   (약 1,200RPM에서 CPU 100%). 벡터에 직접 붙이면 약 2~3us로 줄어 여유가 두 배가 된다.
//   ※ 그래서 이 파일은 핀이 D2/D3에 고정이다 — readAB()의 포트 읽기와 이 벡터 이름 둘 다
//     D2/D3 전용이므로, 핀을 바꾸려면 두 곳을 함께 고쳐야 한다.
ISR(INT4_vect) { encStep(); }
ISR(INT5_vect) { encStep(); }


// ================= 영점 재설정 =================
// 지금 위치를 0으로 만든다.
// ★ enc_state는 건드리지 않는다 ★ 그것은 진행 중인 쿼드러처 전이의 판정 기준이라,
//   여기서 다시 읽어 넣으면 마침 대기 중이던 엣지를 한 카운트 잃을 수 있다.
//   위치의 기준점만 옮기는 것이 목적이므로 카운터만 0으로 두면 충분하다.
void zeroHere() {
  noInterrupts();
  enc_count = 0;
  enc_err   = 0;   // 오차 원인을 새로 세기 위해 유실 카운터도 함께 초기화한다
  enc_dir   = 0;   // 방향 추정도 리셋 (직전 구간의 방향을 새 구간에 물려 쓰지 않도록)
  interrupts();
  Serial.println("# ZERO (지금 위치를 0으로)");   // '#'로 시작해 시리얼 플로터가 무시한다
}


// ================= 시리얼 입력 (줄 단위, "0"만 인정) =================
char rxBuf[8];
uint8_t rxLen = 0;

void pollSerial() {
  while (Serial.available() > 0) {
    char ch = (char)Serial.read();
    if (ch == '\r') continue;
    if (ch == '\n') {
      rxBuf[rxLen] = '\0';
      if (rxLen == 1 && rxBuf[0] == '0') zeroHere();   // 정확히 "0" 한 줄일 때만
      rxLen = 0;
    } else if (rxLen < sizeof(rxBuf) - 1) {
      rxBuf[rxLen++] = ch;
    } else {
      rxLen = 0;   // 너무 긴 줄은 버린다
    }
  }
}


// ================= setup =================
void setup() {
  Serial.begin(BAUD);

  const uint8_t mode = USE_PULLUP ? INPUT_PULLUP : INPUT;
  pinMode(ENC_A_PIN, mode);
  pinMode(ENC_B_PIN, mode);

  // 현재 레벨을 시작 상태로 채택한 뒤 인터럽트를 건다.
  // (먼저 걸면 enc_state가 0이라 첫 전이가 엉뚱하게 판정될 수 있다)
  enc_state = readAB();
  enc_count = 0;                 // ★ 켜진 순간의 위치가 영점 ★
  enc_err   = 0;

  // ── 외부 인터럽트 INT4(D2)·INT5(D3)를 양쪽 엣지(CHANGE)로 직접 설정 ──
  //   attachInterrupt 대신 레지스터를 직접 만지는 이유는 위 ISR 주석 참고(오버헤드 절감).
  //   INT4~INT7은 EICRB가 담당하고, 감지 방식은 2비트다: 00=LOW, 01=양쪽엣지, 10=하강, 11=상승.
  //   -> ISCn1=0, ISCn0=1 이 CHANGE에 해당한다.
  EICRB = (EICRB & ~((1 << ISC41) | (1 << ISC40) | (1 << ISC51) | (1 << ISC50)))
                 | (1 << ISC40) | (1 << ISC50);
  EIFR  = (1 << INTF4) | (1 << INTF5);    // 설정 중에 쌓인 대기 플래그를 지운 뒤
  EIMSK |= (1 << INT4) | (1 << INT5);     // 두 인터럽트를 활성화

  // 이후로는 '숫자 한 줄'만 나가야 하므로 안내는 여기서 한 번만 찍는다.
  // (시리얼 플로터로 볼 때 이 줄들은 그래프에 잡히지 않고 무시된다)
  Serial.println();
  Serial.println("# linear_0803_pot : 리니어 행정 최대/최소 실측");
  Serial.println("# 지금 위치가 0. 로드를 반대쪽 끝까지 움직인 뒤 마지막 숫자를 읽으세요.");
  Serial.print  ("# 출력 주기 ");
  Serial.print(REPORT_MS);
  Serial.println("ms, 값이 안 변해도 매 주기 출력 (1카운트 = 0.044도)");
  Serial.println("# 영점 재설정 : 시리얼로 \"0\" 입력(개행 전송) 또는 아두이노 리셋 버튼");
  Serial.println("# 인터럽트 : INT4(D2)/INT5(D3) 벡터 직결, 양쪽 엣지 x4");
  Serial.println("# \"# ERR\" 줄이 나오면 엣지 유실 — 안 나오면 누락은 없다");
}


// ================= loop =================
// 출력은 '영점 대비 변화량' 정수 하나뿐이다. 매 REPORT_MS마다 조건 없이 찍는다.
void loop() {
  static unsigned long next_t = 0;   // 다음 출력 시각 (0 = 아직 기준을 안 잡음)

  // ★ 아래 출력 주기 판정보다 먼저 읽어야 한다 ★ 출력 차례가 아니면 곧바로 return하므로,
  //   뒤에 두면 20ms에 한 번만 시리얼을 확인하게 되어 입력이 씹힐 수 있다.
  pollSerial();

  unsigned long now = millis();
  if (next_t == 0) next_t = now;     // 첫 진입에서 기준을 잡고 바로 한 줄 찍는다
  if ((long)(now - next_t) < 0) return;

  // ★ 등간격 유지 ★ next_t에 주기를 '누적'한다(now로 갈아치우지 않는다).
  //   그래야 한 번 늦게 깨어나도 다음 표본이 그만큼 앞당겨져 평균 주기가 20ms로 유지된다.
  //   단, 크게 밀린 경우(다른 일로 한 주기 이상 놓친 경우)는 따라잡기를 포기하고 기준을
  //   다시 잡는다 — 밀린 만큼 몰아서 찍으면 표본 간격이 오히려 더 망가진다.
  next_t += REPORT_MS;
  if ((long)(now - next_t) > (long)REPORT_MS) next_t = now + REPORT_MS;

  long     count;
  uint16_t err;
  noInterrupts();
  count = enc_count;   // 4바이트 읽기는 원자적이지 않다 (ISR과 겹치지 않게)
  err   = enc_err;
  interrupts();

  Serial.println(count);

  // ★ 엣지를 놓쳤을 때만 한 줄 더 ★ 평소에는 숫자만 나가고, 누락이 생긴 순간에만 나타난다.
  //   '#'로 시작하므로 시리얼 플로터는 이 줄을 무시한다.
  //   이 줄이 안 나오는데도 같은 위치에서 값이 틀어진다면 전기적 누락이 아니라
  //   기계적 유격(커플링/미끄러짐)이나 '같은 위치' 판정 오차다 — 헤더 참고.
  static uint16_t last_err = 0;
  if (err != last_err) {
    last_err = err;
    Serial.print("# ERR ");
    Serial.print(err);
    Serial.println(" (엣지 유실 누적 — 회전이 너무 빠르거나 배선 노이즈)");
  }
}
